## src/Kconfig
```kconfig
rsource "core-comms/Kconfig"
rsource "rtc/Kconfig"
rsource "supervisor/Kconfig"
rsource "satcom/Kconfig"
rsource "display/Kconfig"
rsource "monitor/Kconfig"
```

## src/core-comms/Kconfig
```kconfig
config CORE_COMMS_MODULE
	bool "Core Comms Module"
	select SERIAL
	select UART_INTERRUPT_DRIVEN
	select NANOPB
	select ZBUS
	select ZBUS_CHANNEL_NAME
	help
	  CORE COMMS MODULE

if CORE_COMMS_MODULE
module = CORE_COMMS_MODULE
module-str = core comms module
source "subsys/logging/Kconfig.template.log_config"

config CORE_COMMS_MODULE_PRIORITY
	int "Core comms module thread priority"
	default 1

config CORE_COMMS_MODULE_STACK_SIZE
	int "Core comms module thread stack size"
	default 8192

endif
```

## src/display/Kconfig
```kconfig
config DISPLAY_MODULE
	bool "Display Module"
	select ZBUS
	select ZBUS_CHANNEL_NAME
	help
	  DISPLAY MODULE

if DISPLAY_MODULE
module = DISPLAY_MODULE
module-str = Display module
source "subsys/logging/Kconfig.template.log_config"

config DISPLAY_MODULE_PRIORITY
	int "Display module thread priority"
	default 1

config DISPLAY_MODULE_STACK_SIZE
	int "Display module thread stack size"
	default 8192

endif
```

## src/monitor/Kconfig
```kconfig
config MONITOR_MODULE
	bool "Monitor Module"
	select GPIO
	select ADC
	select SENSOR
	select ZBUS
	select ZBUS_CHANNEL_NAME
	help
	  MONITOR MODULE

if MONITOR_MODULE

config MONITOR_USE_FAKE_BATTERY
	bool "Use simulated battery data (for testing)"
	default n
	help
	  When enabled, the monitor module uses fake simulated battery data
	  instead of reading from the INA219 sensor hardware.

module = MONITOR_MODULE
module-str = Monitor module
source "subsys/logging/Kconfig.template.log_config"

config MONITOR_MODULE_PRIORITY
	int "Monitor module thread priority"
	default 1

config MONITOR_MODULE_STACK_SIZE
	int "Monitor module thread stack size"
	default 8192

endif
```

## src/rtc/Kconfig
```kconfig
config RTC_MODULE
	bool "RTC Module"
	select RTC
	select I2C
	select ZBUS
	select ZBUS_CHANNEL_NAME
	help
	  RTC MODULE

if RTC_MODULE

module = RTC_MODULE
module-str = RTC module
source "subsys/logging/Kconfig.template.log_config"

endif
```

## src/satcom/Kconfig
```kconfig
config SATCOM_MODULE
	bool "Satcom Module"
	select SERIAL
	select UART_INTERRUPT_DRIVEN
	select ARGOS_SMD
	select ZBUS
	select ZBUS_CHANNEL_NAME
	select RTC_MODULE
	help
	  CORE COMMS MODULE

config SATCOM_SCHEDULER_TX_DELAY_MS
	int "Delay before a scheduled transmission (initial or retry) is sent"
	range 1 3600000
	default 60000
	help
	  Milliseconds a queued transmission waits before the scheduler fires.
	  Lowered by tests to avoid minute-long runtimes.

if SATCOM_MODULE
module = SATCOM_MODULE
module-str = Satcom module
source "subsys/logging/Kconfig.template.log_config"

config SATCOM_MODULE_PRIORITY
	int "Satcom module thread priority"
	default 1

config SATCOM_MODULE_STACK_SIZE
	int "Satcom module thread stack size"
	default 16384

endif
```

## src/supervisor/Kconfig
```kconfig
config SUPERVISOR_MODULE
	bool "Supervisor Module"
	select ZBUS
	select ZBUS_CHANNEL_NAME
	select GPIO
	select EVENTS
	help
	  CORE COMMS MODULE

config CORE_COMMS_CORE_RESET_THRESHOLD
	int "Consecutive core-comms timeouts before notifying the supervisor to reset the Core"
	default 1

if SUPERVISOR_MODULE
module = SUPERVISOR_MODULE
module-str = supervisor module
source "subsys/logging/Kconfig.template.log_config"

config SUPERVISOR_MODULE_PRIORITY
	int "Supervisor module thread priority"
	default 1

config SUPERVISOR_MODULE_STACK_SIZE
	int "Supervisor module thread stack size"
	default 8192

config SUPERVISOR_CORE_RESET_PULSE_MS
	int "Core reset pulse duration in milliseconds"
	default 500

config SUPERVISOR_CORE_RESET_POST_PULSE_DELAY_MS
	int "Delay after releasing the core reset line before re-enabling, in milliseconds"
	default 30000

config SUPERVISOR_CORE_RESET_RETRY_SECONDS
	int "Seconds between core reset pulses while in SystemError state"
	default 180

endif
```

## tests/core-comms/nanopb/testcase.yaml
```yaml
tests:
  core-comms.nanopb:
    platform_allow:
      - native_sim
      - native_sim/native/64
    integration_platforms:
      - native_sim
```
